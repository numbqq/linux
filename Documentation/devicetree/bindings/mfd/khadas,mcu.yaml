## Documentation/devicetree/bindings/mfd/khadas,mcu.yaml
```yaml
# SPDX-License-Identifier: (GPL-2.0-only OR BSD-2-Clause)
%YAML 1.2
---
$id: http://devicetree.org/schemas/mfd/khadas,mcu.yaml#
$schema: http://devicetree.org/meta-schemas/core.yaml#

title: Khadas on-board Microcontroller

maintainers:
  - Neil Armstrong <neil.armstrong@linaro.org>

description: |
  Khadas embeds a microcontroller on their VIM and Edge boards adding some
  system feature as PWM Fan control (for VIM2 rev14 or VIM3), User memory
  storage, IR/Key resume control, system power LED control and more.

properties:
  compatible:
    enum:
      - khadas,mcu # MCU revision is discoverable
      - khadas,vim4-mcu

  "#cooling-cells": # Only needed for boards having FAN control feature
    const: 2

  reg:
    maxItems: 1

  fan-supply:
    description: Phandle to the regulator that powers the fan.
    $ref: /schemas/types.yaml#/definitions/phandle

required:
  - compatible
  - reg

additionalProperties: false

examples:
  - |
    i2c {
      #address-cells = <1>;
      #size-cells = <0>;
      khadas_mcu: system-controller@18 {
        compatible = "khadas,mcu";
        reg = <0x18>;
        #cooling-cells = <2>;
      };
    };
```
