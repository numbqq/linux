## drivers/amlogic/watchdog/Kconfig
```kconfig
#
# watchdog configuration
#


menuconfig AMLOGIC_WDT
	bool "Amlogic Watchdog Support"
	select WATCHDOG
	select WATCHDOG_CORE
	default n
	help
	  say y to enable Amlogic watchdog driver.


if AMLOGIC_WDT
config GX_WDT
	tristate "Amlogic Meson GXBB SoCs watchdog support"
	default n
	help
	  Say Y here to include support for the watchdog timer
	  in Amlogic Meson GXBB SoCs.
	  To compile this driver as a module, choose M here: the
	  module will be called gxbb_wdt.
endif
```
