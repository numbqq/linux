// SPDX-License-Identifier: (GPL-2.0+ OR MIT)
/*
 * Copyright (c) 2018 Shenzhen Wesion Co., Ltd.
 */

/dts-v1/;
#include "rk3399-khadas-edge.dtsi"

/ {
	model = "Khadas Edge";
	compatible = "khadas,edge", "rockchip,rk3399";
};

&gmac {
	status = "disabled";
}; 
